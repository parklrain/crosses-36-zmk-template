## boards/shields/crosses/Kconfig.defconfig
```kconfig
if SHIELD_CROSSES_RIGHT

config ZMK_KEYBOARD_NAME
  default "Crosses BT"

config ZMK_SPLIT_ROLE_CENTRAL
  default y

endif

if SHIELD_CROSSES_LEFT || SHIELD_CROSSES_RIGHT

config ZMK_SPLIT
  default y

endif
```

## config/west.yml
```yaml
manifest:
  remotes:
    - name: zmkfirmware
      url-base: https://github.com/Good-Great-Grand-Wonderful/zmk
      branch: gggw/crosses
    - name: badjeff
      url-base: https://github.com/badjeff
  projects:
    - name: zmk
      remote: zmkfirmware
      revision: v0.2.1
      import: app/west.yml
    - name: zmk-pmw3610-driver
      remote: badjeff
      revision: main
    - name: zmk-input-processor-report-rate-limit
      remote: badjeff
      revision: main
    - name: zmk-input-processor-xyz
      remote: badjeff
      revision: main
    - name: zmk-behavior-insomnia
      remote: badjeff
      revision: main
  self:
    path: config
```
